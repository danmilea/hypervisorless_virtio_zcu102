/{
	soc {
		uart1: uart@ff010000 {
			compatible = "xlnx,xuartps";
			reg = <0xff010000 0x4c>;
			status = "disabled";
			interrupts = <GIC_SPI 22 IRQ_TYPE_LEVEL
					IRQ_DEFAULT_PRIORITY>;
			interrupt-names = "irq_1";
			label = "UART_1";
		};
	};

	chosen {
		zephyr,console = &uart1;
		zephyr,shell-uart = &uart1;
	};
};

&uart1 {
	status = "okay";
	current-speed = <115200>;
	clock-frequency = <99999901>;
};

/delete-node/ &uart0;
/delete-node/ &gem0;
/delete-node/ &gem1;
/delete-node/ &gem2;
/delete-node/ &gem3;



